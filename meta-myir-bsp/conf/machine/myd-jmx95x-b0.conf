## meta-myir-bsp/recipes-myir/swupdate/swupdate/defconfig
```kconfig
#
# SWUpdate configuration for MYD-JMX95X (Yocto 6.0 / swupdate 2026.05.1)
# Ported from the MYD-JS8MPQ reference layer; signature verification and
# encrypted images are enabled. Generated from the validated oldconfig output.
#
CONFIG_HAVE_DOT_CONFIG=y


CONFIG_CURL=y
CONFIG_CURL_SSL=y
CONFIG_SYSTEMD=y
CONFIG_DEFAULT_CONFIG_FILE="/etc/swupdate.cfg"
CONFIG_SCRIPTS=y
CONFIG_HW_COMPATIBILITY=y
CONFIG_HW_COMPATIBILITY_FILE="/etc/hwrevision"
CONFIG_SW_VERSIONS_FILE="/etc/sw-versions"

CONFIG_SOCKET_CTRL_PATH=""
CONFIG_SOCKET_PROGRESS_PATH=""

# CONFIG_MTD is not set
CONFIG_LUA=y
CONFIG_LUAPKG="lua"

CONFIG_CROSS_COMPILE=""
CONFIG_SYSROOT=""
CONFIG_EXTRA_LDLIBS=""

# CONFIG_DEBUG is not set
# CONFIG_WERROR is not set
# CONFIG_NOCLEANUP is not set


# CONFIG_BOOTLOADER_NONE is not set
# CONFIG_BOOTLOADER_EBG is not set
CONFIG_UBOOT=y
CONFIG_UBOOT_FWENV="/etc/fw_env.config"
CONFIG_UBOOT_DEFAULTENV="/etc/u-boot-imx-initial-env"
# CONFIG_BOOTLOADER_GRUB is not set
# CONFIG_BOOTLOADER_CBOOT is not set

CONFIG_BOOTLOADER_DEFAULT_UBOOT=y
# CONFIG_BOOTLOADER_STATIC_LINKED is not set
CONFIG_UPDATE_STATE_CHOICE_BOOTLOADER=y
CONFIG_UPDATE_STATE_BOOTLOADER="ustate"

CONFIG_DOWNLOAD=y
CONFIG_DOWNLOAD_SSL=y
CONFIG_CHANNEL_CURL=y
CONFIG_SURICATTA=y

CONFIG_SURICATTA_SSL=y

CONFIG_SURICATTA_HAWKBIT=y
# CONFIG_SURICATTA_LUA is not set
# CONFIG_SURICATTA_GENERAL is not set

CONFIG_WEBSERVER=y
CONFIG_MONGOOSE=y
CONFIG_MONGOOSEIPV6=y
CONFIG_MONGOOSESSL=y


CONFIG_SSL_IMPL_OPENSSL=y
# CONFIG_SSL_IMPL_WOLFSSL is not set
# CONFIG_SSL_IMPL_MBEDTLS is not set
# CONFIG_SSL_IMPL_GPGME is not set
# CONFIG_PKCS11 is not set

CONFIG_SWUPDATE_CRYPTO=y
CONFIG_HASH_VERIFY=y
CONFIG_SIGNED_IMAGES=y
CONFIG_SIGALG_RAWRSA=y

CONFIG_ENCRYPTED_IMAGES=y

CONFIG_CHANNEL_CURL_SSL=y

CONFIG_GUNZIP=y
# CONFIG_XZ is not set
CONFIG_ZSTD=y
# CONFIG_LZ4 is not set


CONFIG_LIBCONFIG=y
CONFIG_PARSERROOT=""
# CONFIG_LUAEXTERNAL is not set
# CONFIG_SETSWDESCRIPTION is not set


CONFIG_ARCHIVE=y
CONFIG_LOCALE=y
CONFIG_BOOTLOADERHANDLER=y
# CONFIG_COPY is not set
# CONFIG_DELTA is not set
# CONFIG_DISKPART is not set
# CONFIG_DISKFORMAT_HANDLER is not set
CONFIG_LUASCRIPTHANDLER=y
# CONFIG_EMBEDDED_LUA_HANDLER is not set
# CONFIG_EMMC_HANDLER is not set
CONFIG_RAW=y
# CONFIG_RDIFFHANDLER is not set
# CONFIG_READBACKHANDLER is not set
# CONFIG_REMOTE_HANDLER is not set
CONFIG_SHELLSCRIPTHANDLER=y
# CONFIG_SWUFORWARDER_HANDLER is not set
# CONFIG_UCFWHANDLER is not set
# CONFIG_UNIQUEUUID is not set


# CONFIG_DOCKER is not set
```
